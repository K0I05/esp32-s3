/**
 * @file main.c
 * @brief explain
 *
 * 0.91 Inch I2C SSD1306 (128x32) OLED Display Module (Model: SH-S091)
 * 
 * examples
 *      https://github.com/olikraus/u8g2
 *      https://github.com/nopnop2002/esp-idf-ssd1306/blob/master/components/ssd1306/ssd1306.h
 *      https://github.com/yanbe/ssd1306-esp-idf-i2c/blob/master/main/ssd1366.h
 *      https://github.com/imxieyi/esp32-i2c-ssd1306-oled/tree/master/main
 * 
 * 
 * image to byte converter: https://mischianti.org/images-to-byte-array-online-converter-cpp-arduino/
 * 
 * 
 * CTRL + SHIFT + P
 * pio run -t menufconfig
 * k & l keys for up or down
 * OR
 * PowerShell prompt: C:\Users\lavco\.platformio\penv\Scripts\platformio.exe run -t menuconfig
 * 
 */
#include <stdio.h>
#include <stdlib.h>
#include <ctype.h>
#include <unistd.h>
#include <limits.h>
#include <string.h>
#include <time.h>
#include <sys/time.h>
#include <math.h>

#include <esp_system.h>
#include <esp_timer.h>
#include <esp_event.h>
#include <esp_log.h>
#include <nvs.h>
#include <nvs_flash.h>
#include <freertos/FreeRTOS.h>
#include <freertos/task.h>

#include <ssd1306.h>
#include <font8x8_latin.h>


#define CONFIG_I2C_0_PORT               I2C_NUM_0
#define CONFIG_I2C_0_SDA_IO             (gpio_num_t)(45) // blue
#define CONFIG_I2C_0_SCL_IO             (gpio_num_t)(48) // yellow
//
#define CONFIG_I2C_0_TASK_NAME          "i2c_0_tsk"
#define CONFIG_I2C_0_TASK_STACK_SIZE    (configMINIMAL_STACK_SIZE * 4)
#define CONFIG_I2C_0_TASK_PRIORITY      (tskIDLE_PRIORITY + 2)

#define CONFIG_APP_TAG                  "SSD1306 [APP]"

// macros
#define CONFIG_I2C_0_MASTER_DEFAULT {                               \
        .clk_source                     = I2C_CLK_SRC_DEFAULT,      \
        .i2c_port                       = CONFIG_I2C_0_PORT,        \
        .scl_io_num                     = CONFIG_I2C_0_SCL_IO,      \
        .sda_io_num                     = CONFIG_I2C_0_SDA_IO,      \
        .glitch_ignore_cnt              = 7,                        \
        .flags.enable_internal_pullup   = true, }


static uint8_t data_tx_img_32x32[128] = {
	0xff, 0xff, 0xff, 0xff, 0xff, 0xff, 0xff, 0xff, 0xff, 0xff, 0xff, 0xff, 0xff, 0xff, 0xff, 0xff, 
	0xff, 0xff, 0xff, 0xff, 0xff, 0xff, 0xff, 0xff, 0xf8, 0x0f, 0xff, 0xff, 0xf7, 0xf7, 0xff, 0xff, 
	0xf7, 0xf3, 0xff, 0xff, 0xf7, 0xf8, 0x00, 0x3f, 0xf7, 0xff, 0xff, 0xbf, 0xf7, 0xff, 0xff, 0xbf, 
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	0xff, 0xff, 0xff, 0xff, 0xff, 0xff, 0xff, 0xff, 0xff, 0xff, 0xff, 0xff, 0xff, 0xff, 0xff, 0xff
};

static uint8_t data_rx_img_32x32[128] = {
	0xff, 0xff, 0xff, 0xff, 0xff, 0xff, 0xff, 0xff, 0xff, 0xff, 0xff, 0xff, 0xff, 0xff, 0xff, 0xff, 
	0xff, 0xff, 0xff, 0xff, 0xff, 0xff, 0xff, 0xff, 0xfe, 0x07, 0x83, 0xff, 0xfd, 0xfb, 0xbb, 0xff, 
	0xfd, 0xf8, 0x38, 0x0f, 0xfd, 0xff, 0xbb, 0xef, 0xfd, 0xff, 0xbb, 0xef, 0xfd, 0xff, 0xbf, 0xef, 
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	0xff, 0xff, 0xff, 0xff, 0xff, 0xff, 0xff, 0xff, 0xff, 0xff, 0xff, 0xff, 0xff, 0xff, 0xff, 0xff
};

// https://www.mischianti.org/2021/07/14/ssd1306-oled-display-draw-images-splash-and-animations-2/
uint8_t batman[] = {
		0b11111111, 0b11111111, 0b11111111, 0b11111111,
		0b11111111, 0b10011111, 0b11111001, 0b11111111,
		0b11111110, 0b00111110, 0b01111100, 0b01111111,
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		0b11111111, 0b11111111, 0b11111111, 0b11111111
};

// https://www.mischianti.org/2021/07/14/ssd1306-oled-display-draw-images-splash-and-animations-2/
uint8_t logo_mischianti [1024] = {
		// 'logoBN128x64, 128x64px
		0x00, 0x00, 0x00, 0x00, 0x00, 0x00, 0x00, 0xc0, 0x03, 0x00, 0x00, 0x00, 0x00, 0x00, 0x00, 0x00,
		0x00, 0x00, 0x00, 0x00, 0x00, 0x00, 0x01, 0xe0, 0x07, 0x80, 0x00, 0x00, 0x00, 0x00, 0x00, 0x00,
		0x00, 0x00, 0x00, 0x00, 0x00, 0x00, 0x01, 0xe0, 0x07, 0x80, 0x00, 0x00, 0x00, 0x00, 0x00, 0x00,
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		0x00, 0x00, 0x00, 0x00, 0x00, 0x00, 0x00, 0x00, 0x00, 0x00, 0x00, 0x00, 0x00, 0x00, 0x3c, 0x00
};

// https://iitestudent.blogspot.com/2013/01/displaying-bitmap-on-graphic-lcd.html
uint8_t fleischer [1024] = {
	// 'fleischer_420', 128x64px
	0xff, 0xff, 0xff, 0xff, 0xff, 0xff, 0xff, 0xff, 0xff, 0xff, 0xff, 0xff, 0xff, 0xff, 0xff, 0xff, 
	0xff, 0xff, 0xff, 0xff, 0xff, 0xff, 0xff, 0xff, 0xff, 0xff, 0xff, 0xff, 0xff, 0xff, 0xff, 0xff, 
	0xff, 0xff, 0xff, 0xff, 0xff, 0xff, 0xff, 0xff, 0xff, 0xff, 0xff, 0xff, 0xff, 0xff, 0xff, 0xff, 
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	0x00, 0x00, 0x00, 0x01, 0xcf, 0xce, 0x7f, 0xff, 0xfe, 0x3f, 0xff, 0xff, 0xfe, 0xca, 0x6f, 0xff
};


static inline void vTaskDelayMs(const uint ms) {
    const TickType_t xDelay = (ms / portTICK_PERIOD_MS);
    vTaskDelay( xDelay );
}

static inline void vTaskDelaySecUntil(TickType_t *previousWakeTime, const uint sec) {
    const TickType_t xFrequency = ((sec * 1000) / portTICK_PERIOD_MS);
    vTaskDelayUntil( previousWakeTime, xFrequency );  
}

static void i2c_0_task( void *pvParameters ) {
    TickType_t                  xLastWakeTime;
    //
    //
    // initialize the xLastWakeTime variable with the current time
    xLastWakeTime               = xTaskGetTickCount ();
    //
    //
    // initialize master i2c 0 bus configuration
    i2c_master_bus_config_t     i2c0_master_cfg = CONFIG_I2C_0_MASTER_DEFAULT;
    i2c_master_bus_handle_t     i2c0_bus_hdl;
    //
    // initialize ssd1306 i2c device configuration
    i2c_ssd1306_config_t        ssd1306_dev_cfg = I2C_SSD1306_128x64_CONFIG_DEFAULT;
    i2c_ssd1306_handle_t        ssd1306_dev_hdl;
    //
    //
    // instantiate i2c 0 master bus
    i2c_new_master_bus(&i2c0_master_cfg, &i2c0_bus_hdl);
    if (i2c0_bus_hdl == NULL) {
        ESP_LOGE(CONFIG_APP_TAG, "i2c0 i2c_bus_create handle init failed");
        vTaskDelay(3000 / portTICK_PERIOD_MS);
        // Restart module
	    esp_restart();
    }
    //
    // init i2c devices
    //
    // ssd1306 init device
    i2c_ssd1306_init(i2c0_bus_hdl, &ssd1306_dev_cfg, &ssd1306_dev_hdl);
    if (ssd1306_dev_hdl == NULL) {
        ESP_LOGE(CONFIG_APP_TAG, "i2c0 i2c_bus_device_create ssd1306 handle init failed");
        i2c_del_master_bus( i2c0_bus_hdl ); //delete master i2c bus
        vTaskDelay(3000 / portTICK_PERIOD_MS);
        // Restart module
	    esp_restart();
    }
    //
    // task loop entry point
    for ( ;; ) {
        ESP_LOGI(CONFIG_APP_TAG, "######################## SSD1306 - START #########################");
        //
        //
        //i2c_detect(i2c0_bus_hdl);
        //
        // handle ssd1306 oled display
        //
        int center = 1, top = 1, bottom = 4;
        char lineChar[16];
        uint8_t image[24];

        ESP_LOGI(CONFIG_APP_TAG, "Panel is 128x64");

        // Display x3 text
        ESP_LOGI(CONFIG_APP_TAG, "Display x3 Text");
        i2c_ssd1306_clear_display(ssd1306_dev_hdl, false);
        i2c_ssd1306_set_display_contrast(ssd1306_dev_hdl, 0xff);
        i2c_ssd1306_display_text_x3(ssd1306_dev_hdl, 0, "Hello", 5, false);
        vTaskDelay(3000 / portTICK_PERIOD_MS);

        // Display bitmap icons
        ESP_LOGI(CONFIG_APP_TAG, "Display bitmap icons");
        i2c_ssd1306_set_display_contrast(ssd1306_dev_hdl, 0xff);
        i2c_ssd1306_clear_display(ssd1306_dev_hdl, false);
        i2c_ssd1306_display_bitmap(ssd1306_dev_hdl, 31, 0, data_rx_img_32x32, 32, 32, false);
        vTaskDelay(500 / portTICK_PERIOD_MS);
        i2c_ssd1306_display_bitmap(ssd1306_dev_hdl, 31, 0, data_tx_img_32x32, 32, 32, false);
        vTaskDelay(1000 / portTICK_PERIOD_MS);

        // Display x2 text
        ESP_LOGI(CONFIG_APP_TAG, "Display x2 Text");
        i2c_ssd1306_clear_display(ssd1306_dev_hdl, false);
        i2c_ssd1306_set_display_contrast(ssd1306_dev_hdl, 0xff);
        i2c_ssd1306_display_text_x2(ssd1306_dev_hdl, 0, "{xTEXTx}", 8, false);
        i2c_ssd1306_display_text_x2(ssd1306_dev_hdl, 2, " X2-X2", 6, false);
        vTaskDelay(3000 / portTICK_PERIOD_MS);

        // Display text
        ESP_LOGI(CONFIG_APP_TAG, "Display Text");
        i2c_ssd1306_clear_display(ssd1306_dev_hdl, false);
        i2c_ssd1306_set_display_contrast(ssd1306_dev_hdl, 0xff);
        i2c_ssd1306_display_text(ssd1306_dev_hdl, 0, "SSD1306 128x64", 14, false);
        i2c_ssd1306_display_text(ssd1306_dev_hdl, 1, "Hello World!!", 13, false);
        i2c_ssd1306_display_text(ssd1306_dev_hdl, 2, "SSD1306 128x64", 14, true);
        i2c_ssd1306_display_text(ssd1306_dev_hdl, 3, "Hello World!!", 13, true);
        vTaskDelay(3000 / portTICK_PERIOD_MS);
        
        // Display Count Down
        ESP_LOGI(CONFIG_APP_TAG, "Display Count Down");
        memset(image, 0, sizeof(image));
        i2c_ssd1306_display_image(ssd1306_dev_hdl, top, (6*8-1), image, sizeof(image));
        i2c_ssd1306_display_image(ssd1306_dev_hdl, top+1, (6*8-1), image, sizeof(image));
        i2c_ssd1306_display_image(ssd1306_dev_hdl, top+2, (6*8-1), image, sizeof(image));
        for(int font = 0x39; font > 0x30; font--) {
            memset(image, 0, sizeof(image));
            i2c_ssd1306_display_image(ssd1306_dev_hdl, top+1, (7*8-1), image, 8);
            memcpy(image, font8x8_latin_tr[font], 8);
            if (ssd1306_dev_hdl->flip_enabled) i2c_ssd1306_flip_buffer(image, 8);
            i2c_ssd1306_display_image(ssd1306_dev_hdl, top+1, (7*8-1), image, 8);
            vTaskDelay(1000 / portTICK_PERIOD_MS);
        }
        
        // Scroll Up
        ESP_LOGI(CONFIG_APP_TAG, "Scroll Up");
        i2c_ssd1306_clear_display(ssd1306_dev_hdl, false);
        i2c_ssd1306_set_display_contrast(ssd1306_dev_hdl, 0xff);
        i2c_ssd1306_display_text(ssd1306_dev_hdl, 0, "---Scroll  UP---", 16, true);
        i2c_ssd1306_set_software_scroll(ssd1306_dev_hdl, (ssd1306_dev_hdl->pages - 1), 1);
        for (int line = 0; line < bottom+10; line++) {
            lineChar[0] = 0x01;
            sprintf(&lineChar[1], " Line %02d", line);
            i2c_ssd1306_display_scroll_text(ssd1306_dev_hdl, lineChar, strlen(lineChar), false);
            vTaskDelay(500 / portTICK_PERIOD_MS);
        }
        vTaskDelay(3000 / portTICK_PERIOD_MS);
        
        // Scroll Down
        ESP_LOGI(CONFIG_APP_TAG, "Scroll Down");
        i2c_ssd1306_clear_display(ssd1306_dev_hdl, false);
        i2c_ssd1306_set_display_contrast(ssd1306_dev_hdl, 0xff);
        i2c_ssd1306_display_text(ssd1306_dev_hdl, 0, "--Scroll  DOWN--", 16, true);
        i2c_ssd1306_set_software_scroll(ssd1306_dev_hdl, 1, (ssd1306_dev_hdl->pages - 1) );
        for (int page = 0; page < bottom+10; page++) {
            lineChar[0] = 0x02;
            sprintf(&lineChar[1], " Line %02d", page);
            i2c_ssd1306_display_scroll_text(ssd1306_dev_hdl, lineChar, strlen(lineChar), false);
            vTaskDelay(500 / portTICK_PERIOD_MS);
        }
        vTaskDelay(3000 / portTICK_PERIOD_MS);

        // Page Down
        ESP_LOGI(CONFIG_APP_TAG, "Page Down");
        i2c_ssd1306_clear_display(ssd1306_dev_hdl, false);
        i2c_ssd1306_set_display_contrast(ssd1306_dev_hdl, 0xff);
        i2c_ssd1306_display_text(ssd1306_dev_hdl, 0, "---Page	DOWN---", 16, true);
        i2c_ssd1306_set_software_scroll(ssd1306_dev_hdl, 1, (ssd1306_dev_hdl->pages-1) );
        for (int page = 0; page < bottom+10; page++) {
            if ( (page % (ssd1306_dev_hdl->pages-1)) == 0) i2c_ssd1306_clear_scroll_display(ssd1306_dev_hdl);
            lineChar[0] = 0x02;
            sprintf(&lineChar[1], " Line %02d", page);
            i2c_ssd1306_display_scroll_text(ssd1306_dev_hdl, lineChar, strlen(lineChar), false);
            vTaskDelay(500 / portTICK_PERIOD_MS);
        }
        vTaskDelay(3000 / portTICK_PERIOD_MS);

        // Horizontal Scroll
        ESP_LOGI(CONFIG_APP_TAG, "Horizontal Scroll");
        i2c_ssd1306_clear_display(ssd1306_dev_hdl, false);
        i2c_ssd1306_set_display_contrast(ssd1306_dev_hdl, 0xff);
        i2c_ssd1306_display_text(ssd1306_dev_hdl, center, "Horizontal", 10, false);
        i2c_ssd1306_set_hardware_scroll(ssd1306_dev_hdl, I2C_SSD1306_SCROLL_RIGHT, I2C_SSD1306_SCROLL_2_FRAMES);
        vTaskDelay(5000 / portTICK_PERIOD_MS);
        i2c_ssd1306_set_hardware_scroll(ssd1306_dev_hdl, I2C_SSD1306_SCROLL_LEFT, I2C_SSD1306_SCROLL_2_FRAMES);
        vTaskDelay(5000 / portTICK_PERIOD_MS);
        i2c_ssd1306_set_hardware_scroll(ssd1306_dev_hdl, I2C_SSD1306_SCROLL_STOP, I2C_SSD1306_SCROLL_2_FRAMES);
        
        // Vertical Scroll
        ESP_LOGI(CONFIG_APP_TAG, "Vertical Scroll");
        i2c_ssd1306_clear_display(ssd1306_dev_hdl, false);
        i2c_ssd1306_set_display_contrast(ssd1306_dev_hdl, 0xff);
        i2c_ssd1306_display_text(ssd1306_dev_hdl, center, "Vertical", 8, false);
        i2c_ssd1306_set_hardware_scroll(ssd1306_dev_hdl, I2C_SSD1306_SCROLL_DOWN, I2C_SSD1306_SCROLL_2_FRAMES);
        vTaskDelay(5000 / portTICK_PERIOD_MS);
        i2c_ssd1306_set_hardware_scroll(ssd1306_dev_hdl, I2C_SSD1306_SCROLL_UP, I2C_SSD1306_SCROLL_2_FRAMES);
        vTaskDelay(5000 / portTICK_PERIOD_MS);
        i2c_ssd1306_set_hardware_scroll(ssd1306_dev_hdl, I2C_SSD1306_SCROLL_STOP, I2C_SSD1306_SCROLL_2_FRAMES);

        // Bitmaps
        ESP_LOGI(CONFIG_APP_TAG, "Bitmaps");
        i2c_ssd1306_display_text(ssd1306_dev_hdl, 1, "BATMAN", 6, false);
		int bitmapWidth = 4*8;
		int width = ssd1306_dev_hdl->width;
		int xpos = width / 2; // center of width
		xpos = xpos - bitmapWidth/2; 
		int ypos = 16;
		ESP_LOGD(CONFIG_APP_TAG, "width=%d xpos=%d", width, xpos);
		i2c_ssd1306_display_bitmap(ssd1306_dev_hdl, xpos, ypos, batman, 32, 13, false);
		vTaskDelay(3000 / portTICK_PERIOD_MS);
		for(int i=0;i<128;i++) {
			i2c_ssd1306_set_display_wrap_arround(ssd1306_dev_hdl, I2C_SSD1306_SCROLL_RIGHT, 2, 3, 0);
		}
		vTaskDelay(2000 / portTICK_PERIOD_MS);

        i2c_ssd1306_clear_display(ssd1306_dev_hdl, false);
		i2c_ssd1306_display_bitmap(ssd1306_dev_hdl, 0, 0, logo_mischianti, 128, 64, false);
		vTaskDelay(2000 / portTICK_PERIOD_MS);
		for(int i=0;i<64;i++) {
			i2c_ssd1306_set_display_wrap_arround(ssd1306_dev_hdl, I2C_SSD1306_SCROLL_UP, 0, 127, 0);
		}
		vTaskDelay(2000 / portTICK_PERIOD_MS);
		i2c_ssd1306_clear_display(ssd1306_dev_hdl, false);
		i2c_ssd1306_display_bitmap(ssd1306_dev_hdl, 0, 0, fleischer, 128, 64, false);
		vTaskDelay(2000 / portTICK_PERIOD_MS);

        // Invert
        ESP_LOGI(CONFIG_APP_TAG, "Invert");
        i2c_ssd1306_clear_display(ssd1306_dev_hdl, true);
        i2c_ssd1306_set_display_contrast(ssd1306_dev_hdl, 0xff);
        i2c_ssd1306_display_text(ssd1306_dev_hdl, center, "  Good Bye!!", 12, true);
        vTaskDelay(5000 / portTICK_PERIOD_MS);

        // Fade Out
        ESP_LOGI(CONFIG_APP_TAG, "Fade Out");
        i2c_ssd1306_fadeout_display(ssd1306_dev_hdl);
        //
        //
        ESP_LOGI(CONFIG_APP_TAG, "######################## SSD1306 - END ###########################");
        //
        //
        // pause the task per defined wait period
        vTaskDelaySecUntil( &xLastWakeTime, 120 );
    }
    //
    // free up task resources and remove task from stack
    i2c_ssd1306_rm( ssd1306_dev_hdl );      //remove ssd1306 device from master i2c bus
    i2c_del_master_bus( i2c0_bus_hdl ); //delete master i2c bus
    vTaskDelete( NULL );
}


void app_main( void ) {
    ESP_LOGI(CONFIG_APP_TAG, "Startup..");
    ESP_LOGI(CONFIG_APP_TAG, "Free memory: %lu bytes", esp_get_free_heap_size());
    ESP_LOGI(CONFIG_APP_TAG, "IDF version: %s", esp_get_idf_version());

    esp_log_level_set("*", ESP_LOG_INFO);
    esp_log_level_set(CONFIG_APP_TAG, ESP_LOG_VERBOSE);

    esp_err_t ret = nvs_flash_init();
    if (ret == ESP_ERR_NVS_NO_FREE_PAGES || ret == ESP_ERR_NVS_NEW_VERSION_FOUND) {
      ESP_ERROR_CHECK( nvs_flash_erase() );
      ret = nvs_flash_init();
    }
    ESP_ERROR_CHECK( ret );

    xTaskCreatePinnedToCore( 
        i2c_0_task, 
        CONFIG_I2C_0_TASK_NAME, 
        CONFIG_I2C_0_TASK_STACK_SIZE, 
        NULL, 
        CONFIG_I2C_0_TASK_PRIORITY, 
        NULL, 
        APP_CPU_NUM );
        
}